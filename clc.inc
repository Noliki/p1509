// File: clc.inc
// Generated by CLC Designer, Version: 1.0.0.4
// Date: 22.07.2013 16:25
// Device:PIC16(L)F1508/9

	CLC1GLS0 = 0x01;
	CLC1GLS1 = 0x08;
	CLC1GLS2 = 0x00;
	CLC1GLS3 = 0x00;
	CLC1SEL0 = 0x71;
	CLC1SEL1 = 0x00;
	CLC1POL  = 0x80;
	CLC1CON  = 0xC0;

	CLC2GLS0 = 0x02;
	CLC2GLS1 = 0x08;
	CLC2GLS2 = 0x00;
	CLC2GLS3 = 0x00;
	CLC2SEL0 = 0x70;
	CLC2SEL1 = 0x00;
	CLC2POL  = 0x80;
	CLC2CON  = 0xC0;

	CLC3GLS0 = 0x01;
	CLC3GLS1 = 0x00;
	CLC3GLS2 = 0x00;
	CLC3GLS3 = 0x40;
	CLC3SEL0 = 0x00;
	CLC3SEL1 = 0x50;
	CLC3POL  = 0x00;
	CLC3CON  = 0xC3;

	CLC4GLS0 = 0x02;
	CLC4GLS1 = 0x00;
	CLC4GLS2 = 0x00;
	CLC4GLS3 = 0x80;
	CLC4SEL0 = 0x00;
	CLC4SEL1 = 0x50;
	CLC4POL  = 0x00;
	CLC4CON  = 0xC1;

